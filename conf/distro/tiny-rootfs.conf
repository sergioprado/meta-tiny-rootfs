## conf/distro/tiny-rootfs.conf
```bitbake
require conf/distro/poky.conf

DISTRO_NAME = "Tiny Rootfs Operating System"
DISTRO_VERSION = "1.0.0"

MAINTAINER = "Sergio Prado <sergio.prado@e-labworks.com>"

INIT_MANAGER = "mdev-busybox"

TCLIBC = "musl"

FULL_OPTIMIZATION="-Os -pipe ${DEBUG_FLAGS}"

DISTRO_EXTRA_RDEPENDS = ""
DISTRO_EXTRA_RRECOMMENDS = ""

DISTRO_FEATURES = ""

NO_RECOMMENDATIONS = "1"

require conf/machine/include/${MACHINE}-custom.inc
```

## conf/layer.conf
```bitbake
# We have a conf and classes directory, add to BBPATH
BBPATH .= ":${LAYERDIR}"

# We have recipes-* directories, add to BBFILES
BBFILES += "${LAYERDIR}/recipes-*/*/*.bb \
            ${LAYERDIR}/recipes-*/*/*.bbappend"

BBFILE_COLLECTIONS += "meta-tiny-rootfs"
BBFILE_PATTERN_meta-tiny-rootfs = "^${LAYERDIR}/"
BBFILE_PRIORITY_meta-tiny-rootfs = "10"

LAYERDEPENDS_meta-tiny-rootfs = "core"
LAYERSERIES_COMPAT_meta-tiny-rootfs = "scarthgap"
```

## conf/machine/include/qemux86-64-custom.inc
```bitbake
MACHINE_ESSENTIAL_EXTRA_RDEPENDS = ""
MACHINE_ESSENTIAL_EXTRA_RRECOMMENDS = ""

MACHINE_EXTRA_RRDEPENDS = ""
MACHINE_EXTRA_RRECOMMENDS = ""

MACHINE_FEATURES = ""
```
